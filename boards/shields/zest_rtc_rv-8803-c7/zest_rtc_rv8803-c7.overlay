/*
 * Copyright (c) 2024, CATIE
 * SPDX-License-Identifier: Apache-2.0
 */

#include <zephyr/dt-bindings/gpio/sixtron-header.h>

#define PERIPHERAL_ZEST_RTC_RV8803_C7(port) \
	i2c_zest_rtc_rv8803_##port: &sixtron_connector_##port##_i2c {};

#define DRIVERS_ZEST_RTC_RV8803_C7(port) \
	&i2c_zest_rtc_rv8803_##port { \
		status = "okay"; \
		mfd_zest_rtc_rv8803_##port: rv8803##port@32 { \
			compatible = "microcrystal,rv8803-catie"; \
			reg = <0x32>; \
			irq-gpios = <&sixtron_connector_##port DIO2 (GPIO_ACTIVE_LOW | GPIO_PULL_UP)>; \
			rtc_zest_rtc_rv8803_##port: rv8803-rtc##port { \
				compatible = "microcrystal,rv8803-rtc-catie"; \
			}; \
			counter_zest_rtc_rv8803_##port: rv8803-cnt##port { \
				compatible = "microcrystal,rv8803-cnt-catie"; \
				frequency = "1"; \
			}; \
			clock_zest_rtc_rv8803_##port: rv8803-clk##port { \
				compatible = "microcrystal,rv8803-clk-catie"; \
				#clock-cells = <0>; \
			}; \
		}; \
	};

#define ZEST_RTC_RV8803_C7(port) \
	PERIPHERAL_ZEST_RTC_RV8803_C7(port) \
	DRIVERS_ZEST_RTC_RV8803_C7(port)
