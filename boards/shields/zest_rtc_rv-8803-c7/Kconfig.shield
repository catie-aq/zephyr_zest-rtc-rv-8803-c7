## boards/shields/zest_rtc_rv-8803-c7/Kconfig.shield
```kconfig
# Copyright (c) 2024 CATIE
# SPDX-License-Identifier: Apache-2.0

config SHIELD_ZEST_RTC_RV_8803_C7
	def_bool $(shields_list_contains,zest_rtc_rv-8803-c7)
	select I2C

config SHIELD_ZEST_RTC_RV_8803_C7_ALT
	def_bool $(shields_list_contains,zest_rtc_rv-8803-c7_alt)
	select I2C
```
